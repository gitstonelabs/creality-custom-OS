## rootfs/Config.in
```kconfig
# gitStoneLabs external tree — package menu

menu "gitStoneLabs custom packages"

source "$BR2_EXTERNAL_GITSTONELABS_PATH/package/aic8800-driver/Config.in"
source "$BR2_EXTERNAL_GITSTONELABS_PATH/package/aic8800-firmware/Config.in"
source "$BR2_EXTERNAL_GITSTONELABS_PATH/package/klipper/Config.in"
source "$BR2_EXTERNAL_GITSTONELABS_PATH/package/moonraker/Config.in"
source "$BR2_EXTERNAL_GITSTONELABS_PATH/package/creality-cfs-klipper/Config.in"
source "$BR2_EXTERNAL_GITSTONELABS_PATH/package/fluidd/Config.in"

endmenu
```

## rootfs/package/aic8800-driver/Config.in
```kconfig
config BR2_PACKAGE_AIC8800_DRIVER
	bool "aic8800-driver (AIC8800 WiFi+BT kernel modules)"
	depends on BR2_LINUX_KERNEL
	help
	  Out-of-tree kernel driver for AIC8800 series WiFi+BT chipsets,
	  used by the Creality Hi mainboard. Source pulled from vendor BSP.

	  Builds four kernel modules:
	    - aic_bsp     (board support / power sequencing)
	    - aic8800_fdrv (WiFi function driver — cfg80211-based)
	    - aic8800_btlpm (Bluetooth low-power management)
	    - aic8800_btusb (Bluetooth USB transport)

	  Pairs with BR2_PACKAGE_AIC8800_FIRMWARE for the firmware blobs.

comment "aic8800-driver requires a Linux kernel to be built"
	depends on !BR2_LINUX_KERNEL
```

## rootfs/package/aic8800-firmware/Config.in
```kconfig
config BR2_PACKAGE_AIC8800_FIRMWARE
	bool "aic8800-firmware (AIC8800 WiFi+BT firmware blobs)"
	help
	  Firmware blobs for AIC8800D80 and AIC8800DC variants.
	  Installs to /lib/firmware/aic8800{D80,dc}/. Required at runtime
	  by the aic8800-driver kernel modules.
```

## rootfs/package/creality-cfs-klipper/Config.in
```kconfig
config BR2_PACKAGE_CREALITY_CFS_KLIPPER
	bool "creality-cfs-klipper (CFS RS485 module for Klipper)"
	depends on BR2_PACKAGE_KLIPPER
	help
	  gitStoneLabs' GPL-3.0 reverse-engineered replacement for
	  Creality's serial_485_wrapper.cpython-39.so blob — full Python
	  implementation of the CFS RS485 protocol (230400 8N1, 0xF7
	  header, CRC-8/SMBUS).

	  Installs creality_cfs.py and cfs_macros.cfg into Klipper's
	  extras directory plus /etc/klipper/macros/.

	  See: https://github.com/gitstonelabs/creality-cfs-klipper
```

## rootfs/package/fluidd/Config.in
```kconfig
config BR2_PACKAGE_FLUIDD
	bool "fluidd (Klipper web UI)"
	depends on BR2_PACKAGE_MOONRAKER
	help
	  Fluidd is a single-page-app web frontend for Klipper/Moonraker.
	  Installs the static files (HTML/JS/CSS) to /var/www/fluidd.
	  Needs an HTTP server (e.g. nginx or lighttpd) to actually serve
	  the files — the nginx config in our rootfs overlay does this.

	  See: https://docs.fluidd.xyz/

comment "fluidd requires moonraker"
	depends on !BR2_PACKAGE_MOONRAKER
```

## rootfs/package/klipper/Config.in
```kconfig
config BR2_PACKAGE_KLIPPER
	bool "klipper (3D printer firmware host)"
	depends on BR2_PACKAGE_PYTHON3
	select BR2_PACKAGE_PYTHON_PYSERIAL
	select BR2_PACKAGE_PYTHON_GREENLET
	help
	  Klipper is a host-side 3D printer firmware that runs on the SBC
	  and offloads timing-critical work to one or more MCU companions
	  over UART / USB / CAN.

	  This package installs the Klipper Python sources into
	  /opt/klipper and a systemd unit (klipper.service) that runs
	  klippy.py against /etc/klipper/printer.cfg.

	  See: https://www.klipper3d.org/

comment "klipper requires Python 3"
	depends on !BR2_PACKAGE_PYTHON3
```

## rootfs/package/moonraker/Config.in
```kconfig
config BR2_PACKAGE_MOONRAKER
	bool "moonraker (Klipper HTTP/WebSocket API server)"
	depends on BR2_PACKAGE_PYTHON3
	depends on BR2_PACKAGE_KLIPPER
	help
	  Moonraker is the HTTP/WebSocket API in front of Klipper. Required
	  by Fluidd / Mainsail / KlipperScreen web UIs.

	  See: https://github.com/Arksine/moonraker

comment "moonraker requires klipper + Python 3"
	depends on !BR2_PACKAGE_KLIPPER || !BR2_PACKAGE_PYTHON3
```
